## conf/layer.conf
```bitbake
# We have a conf and classes directory, add to BBPATH
BBPATH .= ":${LAYERDIR}"

# We have recipes-* directories, add to BBFILES
BBFILES += "${LAYERDIR}/recipes-*/*/*.bb \
            ${LAYERDIR}/recipes-*/*/*.bbappend"

BBFILE_COLLECTIONS += "meta-nodev-imx8"
BBFILE_PATTERN_meta-nodev-imx8 = "^${LAYERDIR}/"
BBFILE_PRIORITY_meta-nodev-imx8 = "6"

LAYERDEPENDS_meta-nodev-imx8 = "core"
LAYERSERIES_COMPAT_meta-nodev-imx8 = "hardknott"
```
